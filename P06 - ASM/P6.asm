; PRÁCTICA 6
; ALITZEL GALILEA TORRES MACÍAS

		LIST 	P=16F887		; MICROCONTROLADOR A PROGRAMAR
		INCLUDE	"P16F887.INC"	; CARGA LA LIBRERÍA DEL MICROCONTROLADOR	

R0		EQU 	0x20
R1		EQU 	0x21
R2		EQU 	0x22
R3		EQU 	0x23
R4		EQU 	0x24
R5		EQU 	0x25

		ORG 	0x00			; INICIO DE LA PRIMERA INSTRUCCIÓN
		GOTO 	INICIO			; VA A LA ETIQUETA "INICIO"

INICIO	BSF 		STATUS, RP0		; PONE EN 1 A RP0 PARA BANCO 3
		BSF 		STATUS, RP1		; PONE EN 1 A RP1 PARA BANCO 3
		CLRF 	TRISB			; PONE EN 0 A TRISB, DECLARA PUERTO B COMO SALIDA
		CLRF 	ANSEL			; PONE EN 0 A ANSEL
		CLRF 	ANSELH			; PONE EN 0 A ANSELH
		BCF 		STATUS, RP0		; PONE EN 0 A RP0 PARA BANCO 0
		BCF		STATUS, RP1		; PONE EN 0 A RP1 PARA BANCO 0
		CLRF	PORTB
		CALL 	DELAY1

ESTADO	BTFSC 	PORTE, 3			; COMPRUEBA SI EL BIT 3 DEL PUERTO E ESTÁ EN 1
		GOTO 	ESTADO
		CALL 	DELAY2

		INCF	PORTB

BUCLE	BTFSS 	PORTE, 3			; COMPRUEBA SI EL BIT 3 DEL PUERTO E ESTÁ EN 0
		GOTO 	BUCLE
		CALL 	DELAY2
		GOTO 	ESTADO

DELAY1	MOVLW 	.50
		MOVWF	R3
		MOVLW 	.25
		MOVWF 	R4
		MOVLW 	.1
		MOVWF 	R5

CONT_1	DECFSZ 	R3
		GOTO	CONT_1
		DECFSZ 	R4
		GOTO	CONT_1
		DECFSZ 	R5
		GOTO	CONT_1
		RETURN

DELAY2	MOVLW 	.80
		MOVWF	R0
		MOVLW 	.50
		MOVWF 	R1
		MOVLW 	.1
		MOVWF 	R2

CONT_2	DECFSZ 	R0
		GOTO	CONT_2
		DECFSZ 	R1
		GOTO	CONT_2
		DECFSZ 	R2
		GOTO	CONT_2
		RETURN	  
	
		END						; FIN DEL PROGRAMA