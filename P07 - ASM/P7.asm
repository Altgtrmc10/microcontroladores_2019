; PRаCTICA 7
; ALITZEL GALILEA TORRES MACмAS

		LIST 	P=16F887		; MICROCONTROLADOR A PROGRAMAR
		INCLUDE	"P16F887.INC"	; CARGA LA LIBRERмA DEL MICROCONTROLADOR	

R0		EQU 	0x20
R1		EQU 	0x21
R2		EQU		0x22
CUENTA	EQU		0x23

		ORG 	0x00			; INICIO DE LA PRIMERA INSTRUCCIсN
		GOTO 	INICIO			; VA A LA ETIQUETA "INICIO"

INICIO	BSF 		STATUS, RP0		; PONE EN 1 A RP0 PARA BANCO 3
		BSF 		STATUS, RP1		; PONE EN 1 A RP1 PARA BANCO 3
		CLRF 	TRISB			; PONE EN 0 A TRISB, DECLARA PUERTO B COMO SALIDA
		CLRF 	ANSEL			; PONE EN 0 A ANSEL
		CLRF 	ANSELH			; PONE EN 0 A ANSELH
		BCF 		STATUS, RP0		; PONE EN 0 A RP0 PARA BANCO 0
		BCF		STATUS, RP1		; PONE EN 0 A RP1 PARA BANCO 0
		CLRF	PORTB			; PONE EN 0 AL PUERTO B
		CLRF	CUENTA 			; PONE EN 0 A "CUENTA"
		CALL	REBOTE

BUCLE 	MOVLW 	DISPLAY 			; CARGA EN W LA DIRECCIсN DONDE SE ENCUENTRA EL PRIMER VALOR DE LA TABLA
		ADDWF 	CUENTA, 0 		; SUMA EL VALOR DE "CUENTA" PARA OBTENER EL VALOR DE INTERиS
		CALL	TABLA 			; LLAMA A LA SUBRUTINA "TABLA"
		MOVWF 	PORTB 			; MUESTRA DICHO VALOR EN EL DISPLAY DEL PUERTO B
		BTFSS 	PORTE, 3 		; COMPRUEBA SI RE3 ES 1 (SI NO SE PRESIONA EL PULSADOR)
		CALL 	SUMA			; LLAMA A LA SUBRUTINA "SUMA" (SI SE PRESIONA EL PULSADOR)
		GOTO BUCLE

SUMA	INCF 	CUENTA, 1 		; INCREMENTA "CUENTA" EN 1
		MOVLW	0x0A 			; CARGA 0AH EN W
		SUBWF 	CUENTA, 0 		; RESTA "CUENTA" A W
		BTFSC 	STATUS, 2		; COMPRUEBA SI EL RESULTADO HA SIDO 0
		CLRF	CUENTA 			; PONE EN 0 A "CUENTA"
		CALL 	REBOTE 			; LLAMA A LA SUBRUTINA "REBOTE"

ESPERA 	BTFSS 	PORTE, 3
		GOTO 	ESPERA 			; ESPERA QUE SE SUELTE EL PULSADOR PARA REGRESAR
		CALL 	REBOTE 			; LLAMA A LA SUBRUTINA "REBOTE"
		RETURN

REBOTE	MOVLW 	.80
		MOVWF	R0
		MOVLW 	.50
		MOVWF 	R1
		MOVLW 	.1
		MOVWF 	R2

BOUNCE	DECFSZ 	R0
		GOTO	BOUNCE
		DECFSZ 	R1
		GOTO	BOUNCE
		DECFSZ 	R2
		GOTO	BOUNCE
		RETURN	  

TABLA	MOVWF	PCL				; CARGA EL VALOR DE W EN PCL

DISPLAY	RETLW	0x3F			; 0
		RETLW	0x06			; 1
		RETLW	0x5B                   	; 2
		RETLW	0x4F 			; 3
		RETLW	0x66 			; 4
		RETLW	0x6D 			; 5
		RETLW	0x7D 			; 6
		RETLW	0x07 			; 7
		RETLW	0x7F 			; 8
		RETLW	0x6F 			; 9

		END						; FIN DEL PROGRAMA