; CONTROL DE STEPPER CON PULSADORES
; ALITZEL GALILEA TORRES MACÍAS

		LIST 	P=16F887		; MICROCONTROLADOR A PROGRAMAR
		INCLUDE	"P16F887.INC"	; CARGA LA LIBRERÍA DEL MICROCONTROLADOR
	
POS		EQU 	0x20
DC1		EQU 	0x21
DC2		EQU 	0x22

		ORG 	0x00			; INICIO DE LA PRIMERA INSTRUCCIÓN
		GOTO 	INICIO			; VA A LA ETIQUETA "INICIO"

INICIO	BSF 		STATUS, RP0		; PONE EN 1 A RP0 PARA BANCO 3
		BSF 		STATUS, RP1		; PONE EN 1 A RP1 PARA BANCO 3
		CLRF 	TRISB			; PONE EN 0 A TRISB, DECLARA PUERTO B COMO SALIDA
		CLRF 	ANSEL			; PONE EN 0 A ANSEL
		CLRF 	ANSELH			; PONE EN 0 A ANSELH
		BCF 		STATUS, RP0		; PONE EN 0 A RP0 PARA BANCO 0
		BCF		STATUS, RP1		; PONE EN 0 A RP1 PARA BANCO 0

MOTOR	MOVLW  0x03			; INICIALIZAR LA POSICIÓN DEL MOTOR
              MOVWF	POS				;                                       
              MOVWF	PORTB			; 
              CALL	DELAY			; 
		CLRF	PORTB			; APAGA EL DRIVER DEL MOTOR

BUCLE	BTFSS	PORTA, 0		; PRUEBA PULSADOR SENTIDO HORARIO
		CALL 	STEPCW			; LLAMA A LA RUTINA "STEPCW"
		BTFSS	PORTA, 1		; PRUEBA PULSADOR SENTIDO ANTIHORARIO
		CALL	STEPCCW		; LLAMA A LA RUTINA "STEPCCW"
		GOTO	BUCLE			; VA A LA ETIQUERA "BUCLE"
                         
STEPCW							; ROTA UN PASO EN SENTIDO HORARIO
		BCF		STATUS, C		; PONE EN 0 A C
		BTFSC	POS, 3			; PONE EN 1 A C SI EL BIT 3 ES 1
		BSF		STATUS, C
		RLF		POS, W			; ROTA UNA POSICIÓN
		ANDLW	0x0F			; MÁSCARA PARA DISMINUIR EL NIBBLE
              MOVWF	POS				; 
              MOVWF	PORTB			; CONTROLA LAS SALIDAS
		CALL	DELAY			; ESPERA
		CLRF	PORTB			; LIMPIA LAS SALIDAS
		RETURN

                                                                          		
STEPCCW						; ROTA UN PASO EN SENTIDO ANTIHORARIO 	
		BCF		STATUS, C		; PONE EN 0 A C
		BTFSC	POS, 0			; 
		BSF		POS, 4			; 
		RRF		POS, W			; ROTA UNA POSICIÓN
		ANDLW	0x0F			; MÁSCARA PARA DISMINUIR EL NIBBLE
		MOVWF	POS				; 
		MOVWF	PORTB			; CONTROLA LAS SALIDAS
		CALL	DELAY			; ESPERA
		CLRF	PORTB			; LIMPIA LAS SALIDAS
		RETURN

;  ESTA RUTINA IMPLEMENTA EL RETARDO ENTRE PASOS, CONTROLANDO LA VELOCIDAD DEL MOTOR
DELAY	MOVLW	0x18			; BUCLE INFINITO
		MOVWF	DC1				; 		
DL1		CLRF	DC2				; INICIALIZA BUCLE INTERNO
DL2		NOP						; 
		NOP						; 
		DECFSZ	DC2, F			;          
		GOTO	DL2				; 
		DECFSZ	DC1, F			; 
		GOTO	DL1				; 
		RETURN

		END						; FIN DEL PROGRAMA