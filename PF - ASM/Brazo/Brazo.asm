; CONTROL DE STEPPERS CON PULSADORES PARA BRAZO ROBÓTICO DE TRES GRADOS DE LIBERTAD
; ALITZEL GALILEA TORRES MACÍAS

		LIST 	P=16F887		; MICROCONTROLADOR A PROGRAMAR
		INCLUDE	"P16F887.INC"	; CARGA LA LIBRERÍA DEL MICROCONTROLADOR
	
POS_1	EQU 	0x20
POS_2	EQU		0x21
POS_3	EQU		0x22
DC1		EQU 	0x23
DC2		EQU 	0x24

		ORG 	0x00			; INICIO DE LA PRIMERA INSTRUCCIÓN
		GOTO 	INICIO			; VA A LA ETIQUETA "INICIO"

INICIO	BSF 		STATUS, RP0		; PONE EN 1 A RP0 PARA BANCO 3
		BSF 		STATUS, RP1		; PONE EN 1 A RP1 PARA BANCO 3
		CLRF 	ANSEL			; PONE EN 0 A ANSEL
		CLRF 	ANSELH			; PONE EN 0 A ANSELH
		BCF 		STATUS, RP1		; PONE EN 1 A RP1 PARA BANCO 1
		CLRF 	TRISB			; PONE EN 0 A TRISB, DECLARA PUERTO B COMO SALIDA
		CLRF 	TRISC			; PONE EN 0 A TRISC, DECLARA PUERTO C COMO SALIDA
		CLRF 	TRISD			; PONE EN 0 A TRISD, DECLARA PUERTO D COMO SALIDA
		BCF 		STATUS, RP0		; PONE EN 0 A RP0 PARA BANCO 0

M1		MOVLW  0x03			; INICIALIZAR LA POSICIÓN DEL MOTOR 1
              MOVWF	POS_1                            
              MOVWF	PORTB
              CALL	DELAY
		CLRF	PORTB			; APAGA EL DRIVER DEL MOTOR 1

M2		MOVLW  0x03			; INICIALIZAR LA POSICIÓN DEL MOTOR 2
              MOVWF	POS_2                                   
              MOVWF	PORTC
              CALL	DELAY
		CLRF	PORTC			; APAGA EL DRIVER DEL MOTOR 2

M3		MOVLW  0x03			; INICIALIZAR LA POSICIÓN DEL MOTOR 3
              MOVWF	POS_3
              MOVWF	PORTD
              CALL	DELAY
		CLRF	PORTD			; APAGA EL DRIVER DEL MOTOR 3

BUCLE	
MOTOR1	BTFSS	PORTA, 0		; PRUEBA PULSADOR SENTIDO HORARIO DEL MOTOR 1
		CALL 	S_CW_1			; LLAMA A LA RUTINA "S_CW_1"
		BTFSS	PORTA, 1		; PRUEBA PULSADOR SENTIDO ANTIHORARIO DEL MOTOR 1
		CALL	S_CCW_1		; LLAMA A LA RUTINA "S_CCW_1"
MOTOR2	BTFSS	PORTA, 2			; PRUEBA PULSADOR SENTIDO HORARIO DEL MOTOR 2
		CALL 	S_CW_2			; LLAMA A LA RUTINA "S_CW_2"
		BTFSS	PORTA, 3			; PRUEBA PULSADOR SENTIDO ANTIHORARIO DEL MOTOR 2
		CALL	S_CCW_2		; LLAMA A LA RUTINA "S_CCW_2"
MOTOR3	BTFSS	PORTA, 4		; PRUEBA PULSADOR SENTIDO HORARIO DEL MOTOR 3
		CALL 	S_CW_3			; LLAMA A LA RUTINA "S_CW_3"
		BTFSS	PORTA, 5			; PRUEBA PULSADOR SENTIDO ANTIHORARIO DEL MOTOR 3
		CALL	S_CCW_3		; LLAMA A LA RUTINA "S_CCW_3"
		GOTO	BUCLE			; REGRESA PARA HACER LA COMPARACIÓN DE LOS PULSADORES
                         
S_CW_1							; ROTA UN PASO EN SENTIDO HORARIO AL MOTOR 1
		BCF		STATUS, C		; PONE EN 0 AL BIT C
		BTFSC	POS_1, 3		; PONE EN 1 AL BIT C SI EL BIT 3 ES 1
		BSF		STATUS, C
		RLF		POS_1, W		; ROTA UNA POSICIÓN
		ANDLW	0x0F			; MÁSCARA PARA DISMINUIR EL NIBBLE
              MOVWF	POS_1
              MOVWF	PORTB			; CONTROLA LAS SALIDAS
		CALL	DELAY			; ESPERA
		CLRF	PORTB			; LIMPIA LAS SALIDAS
		RETURN                                                                   		
S_CCW_1						; ROTA UN PASO EN SENTIDO ANTIHORARIO AL MOTOR 1	
		BCF		STATUS, C		; PONE EN 0 AL BIT C
		BTFSC	POS_1, 0
		BSF		POS_1, 4
		RRF		POS_1, W		; ROTA UNA POSICIÓN
		ANDLW	0x0F			; MÁSCARA PARA DISMINUIR EL NIBBLE
		MOVWF	POS_1
		MOVWF	PORTB			; CONTROLA LAS SALIDAS
		CALL	DELAY			; ESPERA
		CLRF	PORTB			; LIMPIA LAS SALIDAS
		RETURN

S_CW_2							; ROTA UN PASO EN SENTIDO HORARIO AL MOTOR 2
		BCF		STATUS, C		; PONE EN 0 AL BIT C
		BTFSC	POS_2, 3			; PONE EN 1 AL BIT C SI EL BIT 3 ES 1
		BSF		STATUS, C
		RLF		POS_2, W		; ROTA UNA POSICIÓN
		ANDLW	0x0F			; MÁSCARA PARA DISMINUIR EL NIBBLE
              MOVWF	POS_2
              MOVWF	PORTC			; CONTROLA LAS SALIDAS
		CALL	DELAY			; ESPERA
		CLRF	PORTC			; LIMPIA LAS SALIDAS
		RETURN                                                                   		
S_CCW_2						; ROTA UN PASO EN SENTIDO ANTIHORARIO AL MOTOR 2	
		BCF		STATUS, C		; PONE EN 0 AL BIT C
		BTFSC	POS_2, 0
		BSF		POS_2, 4
		RRF		POS_2, W		; ROTA UNA POSICIÓN
		ANDLW	0x0F			; MÁSCARA PARA DISMINUIR EL NIBBLE
		MOVWF	POS_2
		MOVWF	PORTC			; CONTROLA LAS SALIDAS
		CALL	DELAY			; ESPERA
		CLRF	PORTC			; LIMPIA LAS SALIDAS
		RETURN

S_CW_3							; ROTA UN PASO EN SENTIDO HORARIO AL MOTOR 3
		BCF		STATUS, C		; PONE EN 0 AL BIT C
		BTFSC	POS_3, 3			; PONE EN 1 AL BIT C SI EL BIT 3 ES 1
		BSF		STATUS, C
		RLF		POS_3, W		; ROTA UNA POSICIÓN
		ANDLW	0x0F			; MÁSCARA PARA DISMINUIR EL NIBBLE
              MOVWF	POS_3
              MOVWF	PORTD			; CONTROLA LAS SALIDAS
		CALL	DELAY			; ESPERA
		CLRF	PORTD			; LIMPIA LAS SALIDAS
		RETURN                                                                   		
S_CCW_3						; ROTA UN PASO EN SENTIDO ANTIHORARIO AL MOTOR 3	
		BCF		STATUS, C		; PONE EN 0 AL BIT C
		BTFSC	POS_3, 0
		BSF		POS_3, 4
		RRF		POS_3, W		; ROTA UNA POSICIÓN
		ANDLW	0x0F			; MÁSCARA PARA DISMINUIR EL NIBBLE
		MOVWF	POS_3
		MOVWF	PORTD			; CONTROLA LAS SALIDAS
		CALL	DELAY			; ESPERA
		CLRF	PORTD			; LIMPIA LAS SALIDAS
		RETURN

;  ESTA RUTINA IMPLEMENTA EL RETARDO ENTRE PASOS, CONTROLANDO LA VELOCIDAD DE LOS MOTORES
DELAY	MOVLW	0x08			; BUCLE INFINITO
		MOVWF	DC1				; 		
DL1		CLRF	DC2				; INICIALIZA BUCLE INTERNO
DL2		NOP						; 
		NOP						; 
		DECFSZ	DC2, F			;          
		GOTO	DL2				; 
		DECFSZ	DC1, F			; 
		GOTO	DL1				; 
		RETURN

		END						; FIN DEL PROGRAMA