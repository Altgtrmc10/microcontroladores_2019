; PRÁCTICA 8
; ALITZEL GALILEA TORRES MACÍAS

		LIST 	P=16F887		; MICROCONTROLADOR A PROGRAMAR
		INCLUDE	"P16F887.INC"	; CARGA LA LIBRERÍA DEL MICROCONTROLADOR

R0		EQU		0x20 ;
R1		EQU		0x21 ;
R2		EQU		0x22 ;
MEM	EQU		0x23;

		ORG 	0x00			; INICIO DE LA PRIMERA INSTRUCCIÓN
		GOTO 	INICIO			; VA A LA ETIQUETA "INICIO"

; 0001   NARANJA
; 0010   ROSA
; 0100   AMARILLO
; 1000   AZUL
; COM    ROJO

INICIO	BSF 		STATUS, RP0		; PONE EN 1 A RP0 PARA BANCO 3
		BSF 		STATUS, RP1		; PONE EN 1 A RP1 PARA BANCO 3
		CLRF 	TRISB			; PONE EN 0 A TRISB, DECLARA PUERTO B COMO SALIDA
		CLRF 	ANSEL			; PONE EN 0 A ANSEL
		CLRF 	ANSELH			; PONE EN 0 A ANSELH
		BCF 		STATUS, RP0		; PONE EN 0 A RP0 PARA BANCO 0
		BCF		STATUS, RP1		; PONE EN 0 A RP1 PARA BANCO 0
		CLRF	PORTB

LEER	BCF		STATUS, C
		MOVF	PORTA, W  	 
		MOVWF	MEM	  	
		BTFSS	MEM, 0 	
		GOTO	LEER
		GOTO	LEFT			

LEFT	CALL	TIME 
		CLRF	PORTB
S_1		MOVF	PORTA, W	  	
		MOVWF	MEM  	 
		BTFSC	MEM, 1 	 
		GOTO	RIGHT     	
		MOVLW	.1		
		MOVWF	PORTB      	
X		CALL	TIME
		RLF		PORTB, F	
		BTFSS	PORTB, 3		
		GOTO	X			
		CALL	TIME
		GOTO	S_1

RIGHT	CALL	TIME 
		CLRF	PORTB
S_2		MOVF	PORTA, W
		MOVWF	MEM
		BTFSC	MEM, 2
		GOTO	LEFT
		MOVLW	.8
		MOVWF	PORTB
Y		CALL	TIME
		RRF		PORTB, F
		BTFSS	PORTB, 0
		GOTO	Y			
		CALL	TIME
		GOTO	S_2

TIME 	MOVLW 	.100
		MOVWF 	R0
		MOVLW 	.50
		MOVWF 	R1
		MOVLW 	.1
		MOVWF 	R2
CONT	DECFSZ 	R0, F
		GOTO	CONT 
		DECFSZ 	R1, F
		GOTO 	CONT
		DECFSZ 	R2, F
		GOTO 	CONT
		RETURN
		
		END						; FIN DEL PROGRAMA
