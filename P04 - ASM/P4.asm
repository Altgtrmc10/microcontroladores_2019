; PRÁCTICA 4
; ALITZEL GALILEA TORRES MACÍAS

		LIST 	P=16F887		; MICROCONTROLADOR A PROGRAMAR
		INCLUDE	"P16F887.INC"	; CARGA LA LIBRERÍA DEL MICROCONTROLADOR	

		ORG 	0x00			; INICIO DE LA PRIMERA INSTRUCCIÓN
		GOTO 	INICIO			; VA A LA ETIQUETA "INICIO"

INICIO	BSF 		STATUS, RP0		; PONE EN 1 A RP0 PARA BANCO 3
		BSF 		STATUS, RP1		; PONE EN 1 A RP1 PARA BANCO 3
		CLRF 	TRISB			; PONE EN 0 A TRISB, DECLARA PUERTO B COMO SALIDA
		CLRF 	ANSEL			; PONE EN 0 A ANSEL
		CLRF 	ANSELH			; PONE EN 0 A ANSELH
		BCF 		STATUS, RP0		; PONE EN 0 A RP0 PARA BANCO 0
		BCF		STATUS, RP1		; PONE EN 0 A RP1 PARA BANCO 0

BUCLE

CERO	MOVLW 	0x00			; 0
		XORWF 	PORTA, W
		BTFSS 	STATUS, Z
		GOTO 	UNO
		MOVLW 	0x3F
		MOVWF 	PORTB
		GOTO 	BUCLE

UNO		MOVLW 	0x01			; 1
		XORWF 	PORTA, W
		BTFSS 	STATUS, Z
		GOTO 	DOS
		MOVLW 	0x06
		MOVWF 	PORTB
		GOTO 	BUCLE

DOS		MOVLW 	0x02			; 2
		XORWF 	PORTA, W
		BTFSS 	STATUS, Z
		GOTO 	TRES
		MOVLW 	0x5B
		MOVWF 	PORTB
		GOTO 	BUCLE

TRES	MOVLW 	0x03			; 3
		XORWF 	PORTA, W
		BTFSS 	STATUS, Z
		GOTO 	CUATRO
		MOVLW 	0x4F
		MOVWF 	PORTB
		GOTO 	BUCLE

CUATRO	MOVLW 	0x04			; 4
		XORWF 	PORTA, W
		BTFSS 	STATUS, Z
		GOTO 	CINCO
		MOVLW 	0x66
		MOVWF 	PORTB
		GOTO 	BUCLE

CINCO	MOVLW 	0x05			; 5
		XORWF 	PORTA, W
		BTFSS 	STATUS, Z
		GOTO 	SEIS
		MOVLW 	0x6D
		MOVWF 	PORTB
		GOTO 	BUCLE

SEIS		MOVLW 	0x06			; 6
		XORWF 	PORTA, W
		BTFSS 	STATUS, Z
		GOTO 	SIETE
		MOVLW 	0x7D
		MOVWF 	PORTB
		GOTO 	BUCLE

SIETE	MOVLW 	0x07			; 7
		XORWF 	PORTA, W
		BTFSS 	STATUS, Z
		GOTO 	OCHO
		MOVLW 	0x07
		MOVWF 	PORTB
		GOTO 	BUCLE

OCHO	MOVLW 	0x08			; 8
		XORWF 	PORTA, W
		BTFSS 	STATUS, Z
		GOTO 	NUEVE
		MOVLW 	0x7F
		MOVWF 	PORTB
		GOTO 	BUCLE

NUEVE	MOVLW 	0x09			; 9
		XORWF 	PORTA, W
		BTFSS 	STATUS, Z
		GOTO 	DIEZ
		MOVLW 	0x6F
		MOVWF 	PORTB
		GOTO 	BUCLE

DIEZ	MOVLW 	0x0A			; A
		XORWF 	PORTA, W
		BTFSS 	STATUS, Z
		GOTO 	ONCE
		MOVLW 	0x77
		MOVWF 	PORTB
		GOTO 	BUCLE

ONCE	MOVLW 	0x0B			; B
		XORWF 	PORTA, W
		BTFSS 	STATUS, Z
		GOTO 	DOCE
		MOVLW 	0x7C
		MOVWF 	PORTB
		GOTO 	BUCLE

DOCE	MOVLW 	0x0C			; C
		XORWF 	PORTA, W
		BTFSS 	STATUS, Z
		GOTO 	TRECE
		MOVLW 	0x39
		MOVWF 	PORTB
		GOTO 	BUCLE

TRECE	MOVLW 	0x0D			; D
		XORWF 	PORTA, W
		BTFSS 	STATUS, Z
		GOTO 	CATORCE
		MOVLW 	0x5E
		MOVWF 	PORTB
		GOTO 	BUCLE

CATORCE	MOVLW 	0x0E			; E
		XORWF 	PORTA, W
		BTFSS 	STATUS, Z
		GOTO 	QUINCE
		MOVLW 	0x79
		MOVWF 	PORTB
		GOTO 	BUCLE

QUINCE	MOVLW 	0x0F			; F
		XORWF 	PORTA, W
		BTFSS 	STATUS, Z
		GOTO 	OTROS
		MOVLW 	0x71
		MOVWF 	PORTB
		GOTO	BUCLE

OTROS	MOVLW 	0x80			; PUNTO
		MOVWF 	PORTB
		GOTO 	BUCLE
	
		END						; FIN DEL PROGRAMA